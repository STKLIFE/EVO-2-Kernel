## drivers/input/touchscreen/mediatek/gslx68x/Kconfig
```kconfig
#
# Touchscreen driver configuration
#
config TOUCHSCREEN_MTK_GSLX68X
	tristate "GSLX68X for Mediatek package"
	default n
	help
	  Say Y here if you have GSLX68X touch panel.

	  If unsure, say N.

	  To compile this dirver as a module, choose M here: the
	  module will be called.



config GSLX68X_GESTURE_WAKEUP
	bool "GSLX68X for Mediatek package"
	default n
	help
	Say Y here if you have GSLX68X touch panel GSLX68X_GESTURE_WAKEUP.

	If unsure, say N.

	To compile this dirver as a module, choose M here: the
	module will be called.


config GSLX68X_PROXIMITY
	bool "GSLX68X for Mediatek package"
	default n
	help
	Say Y here if you have GSLX68X touch panel GSLX68X_PROXIMITY.

	If unsure, say N.

	To compile this dirver as a module, choose M here: the
	module will be called.
```

## drivers/input/touchscreen/mediatek/icn87xx/Kconfig
```kconfig
#
# Touchscreen driver configuration
#
config TOUCHSCREEN_MTK_ICN87XX
	bool "ICN87XX for Mediatek package"
	default n
	help
	  Say Y here if you have ICN87XX touch panel.

	  If unsure, say N.

	  To compile this dirver as a module, choose M here: the
	  module will be called.



config ICN87XX_GESTURE_WAKEUP
	bool "ICN87XX for Mediatek package"
	default n
	help
	Say Y here if you have ICN87XX touch panel ICN87XX_GESTURE_WAKEUP.

	If unsure, say N.

	To compile this dirver as a module, choose M here: the
	module will be called.


config ICN87XX_PROXIMITY
	bool "ICN87XX for Mediatek package"
	default n
	help
	Say Y here if you have ICN87XX touch panel ICN87XX_PROXIMITY.

	If unsure, say N.

	To compile this dirver as a module, choose M here: the
	module will be called.
```

## drivers/misc/mediatek/leds/Kconfig
```kconfig
config MTK_LEDS
	tristate "MediaTek LED Support"
	depends on LEDS_CLASS
	---help---
	  This selects the MediaTek(R) LEDs connected to MediaTek chips.
	  If you want to use MediaTek(R) LEDs support, say Y or M here.
	  If unsure, say N.
	  Mediatek LED module includes backlight, indicate LED, keypad LED, button LED etc.

config LIGHTNESS_MAPPING_VALUE
	int "LIGHTNESS_MAPPING_VALUE"
	default 255
 	---help---
	  Backlight brightness mapping value, from 0 to 255.

config BACKLIGHT_SUPPORT_LP8557
	bool "Support backlight lp8557 board"

config BACKLIGHT_SUPPORT_LM3697
	bool "LM3697(DW8832) Support"
	default n
 	---help---
	  charge pump driver for external backlight
	  
config LCM_BACKLIGHT_RESUME_DELAY
	bool "LCM_BACKLIGHT_RESUME_DELAY"
	default n
	help
	  CONFIG LCM BACKLIGHT RESUME DELAY.
	  
config CUSTOM_KERNEL_GPIO_CTL_FLASHLIGHT
        string "CUSTOM_KERNEL_GPIO_CTL_FLASHLIGHT"
        help
          Kernel space cameara gpio ctl flashlight driver. You can use this driver
          choose cameara gpio ctl flashlight type.
```

## drivers/misc/mediatek/sensors-1.0/accelerometer/msa301/Kconfig
```kconfig
config MTK_MSA301
	bool "MSA301 for MediaTek package"
	default n
	help
	  It support different accelerometer sensor.
          If this option is set,
	  it will support
          MSA301 Accelerometer.
```

## drivers/nfc/st21nfc/Kconfig
```kconfig
config NFC_CHIP_SUPPORT
	tristate "NFC ST21NFC support"
	depends on I2C
	---help---
	  This module adds support for the STMicroelectronics st21nfc  interface.
	  Select this if your platform is using the i2c bus.

	  If you choose to build a module, it'll be called st21nfc
	  Say N if unsure.
```
